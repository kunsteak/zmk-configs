## zmk-config-bloq/config/boards/shields/bloq/Kconfig.defconfig
```kconfig
config ZMK_BLE
    default y

config ZMK_USB
    default y

if SHIELD_BLOQ_LEFT

config ZMK_KEYBOARD_NAME
	default "Bloq"

config ZMK_SPLIT_ROLE_CENTRAL
    default y

endif

if SHIELD_BLOQ_LEFT || SHIELD_BLOQ_RIGHT

config ZMK_SPLIT
    default y

endif
```

## zmk-config-bloq/config/boards/shields/bloq/Kconfig.shield
```kconfig
config SHIELD_BLOQ_LEFT
	def_bool $(shields_list_contains,bloq_left)

config SHIELD_BLOQ_RIGHT
	def_bool $(shields_list_contains,bloq_right)
```

## zmk-config-brick/config/boards/shields/brick/Kconfig.defconfig
```kconfig
config ZMK_BLE
    default y

config ZMK_USB
    default y

if SHIELD_BRICK_LEFT

config ZMK_KEYBOARD_NAME
	default "Brick"

config ZMK_SPLIT_ROLE_CENTRAL
    default y

endif

if SHIELD_BRICK_LEFT || SHIELD_BRICK_RIGHT

config ZMK_SPLIT
    default y

endif
```

## zmk-config-brick/config/boards/shields/brick/Kconfig.shield
```kconfig
config SHIELD_BRICK_LEFT
	def_bool $(shields_list_contains,brick_left)

config SHIELD_BRICK_RIGHT
	def_bool $(shields_list_contains,brick_right)
```

## zmk-config-dilly/config/boards/shields/dilly/Kconfig.defconfig
```kconfig
config ZMK_BLE
    default y

config ZMK_USB
    default y

if SHIELD_DILLY_LEFT

config ZMK_KEYBOARD_NAME
	default "Dilly"

config ZMK_SPLIT_ROLE_CENTRAL
    default y

endif

if SHIELD_DILLY_LEFT || SHIELD_DILLY_RIGHT

config ZMK_SPLIT
    default y

endif
```

## zmk-config-dilly/config/boards/shields/dilly/Kconfig.shield
```kconfig
config SHIELD_DILLY_LEFT
	def_bool $(shields_list_contains,dilly_left)

config SHIELD_DILLY_RIGHT
	def_bool $(shields_list_contains,dilly_right)
```

## zmk-config-gr8/config/boards/shields/big-gr8/Kconfig.defconfig
```kconfig
if SHIELD_BIG_GR8_LEFT || SHIELD_BIG_GR8_RIGHT

config ZMK_KEYBOARD_NAME
	default "GR8"

endif
```

## zmk-config-gr8/config/boards/shields/big-gr8/Kconfig.shield
```kconfig
config SHIELD_BIG_GR8_LEFT
	def_bool $(shields_list_contains,big_gr8_left)

config SHIELD_BIG_GR8_RIGHT
	def_bool $(shields_list_contains,big_gr8_right)
```

## zmk-config-gr8/config/boards/shields/gr8/Kconfig.defconfig
```kconfig
if SHIELD_GR8_LEFT || SHIELD_GR8_RIGHT

config ZMK_KEYBOARD_NAME
	default "GR8"

endif
```

## zmk-config-gr8/config/boards/shields/gr8/Kconfig.shield
```kconfig
config SHIELD_GR8_LEFT
	def_bool $(shields_list_contains,gr8_left)

config SHIELD_GR8_RIGHT
	def_bool $(shields_list_contains,gr8_right)
```

## zmk-config-icarus/config/boards/shields/icarus/Kconfig.defconfig
```kconfig
config ZMK_BLE
    default y

config ZMK_USB
    default y

if SHIELD_ICARUS_LEFT

config ZMK_KEYBOARD_NAME
    default "Icarus"

config ZMK_SPLIT_ROLE_CENTRAL
    default y

endif

if SHIELD_ICARUS_LEFT || SHIELD_ICARUS_RIGHT

config ZMK_SPLIT
    default y

endif
```

## zmk-config-icarus/config/boards/shields/icarus/Kconfig.shield
```kconfig
config SHIELD_ICARUS_LEFT
	def_bool $(shields_list_contains,icarus_left)

config SHIELD_ICARUS_RIGHT
	def_bool $(shields_list_contains,icarus_right)
```

## zmk-config-obelisk/config/boards/shields/obelisk/Kconfig.defconfig
```kconfig
# Copyright (c) 2020 The ZMK Contributors
# SPDX-License-Identifier: MIT

config ZMK_BLE
	default y

config ZMK_USB
	default y

if SHIELD_OBELISK_DONGLE || SHIELD_OBELISK_NORM_LEFT || SHIELD_OBELISK_NORM_RIGHT

config ZMK_KEYBOARD_NAME
	default "Obelisk"

endif

if SHIELD_OBELISK_DONGLE_LEFT || SHIELD_OBELISK_DONGLE_RIGHT || SHIELD_OBELISK_NORM_RIGHT

config ZMK_SPLIT
	default y

endif

if SHIELD_OBELISK_DONGLE || SHIELD_OBELISK_NORM_LEFT

config ZMK_SPLIT
	default y

config ZMK_SPLIT_BLE_ROLE_CENTRAL
	default y

endif
```

## zmk-config-obelisk/config/boards/shields/obelisk/Kconfig.shield
```kconfig
# Copyright (c) 2020 The ZMK Contributors
# SPDX-License-Identifier: MIT

config SHIELD_OBELISK_NORM_LEFT
	def_bool $(shields_list_contains,obelisk_norm_left)

config SHIELD_OBELISK_NORM_RIGHT
	def_bool $(shields_list_contains,obelisk_norm_right)
```

## zmk-config-obelisk/config/west.yml
```yaml
manifest:
  remotes:
    - name: kunsteak
      url-base: https://github.com/kunsteak 
  projects:
    - name: zmk
      remote: kunsteak
      revision: repeatrollfix-tapdance-macro-mouse-dongle
      import: app/west.yml
  self:
    path: config
```
