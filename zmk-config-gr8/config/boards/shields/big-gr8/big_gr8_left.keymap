#include <behaviors.dtsi>
#include <dt-bindings/zmk/keys.h>
#include <dt-bindings/zmk/bt.h>
#include <dt-bindings/zmk/outputs.h>
#include <dt-bindings/zmk/mouse.h>

// Left/Right
#define ARDUX_LEFT 1

// ARTS Row
#define EXT_1 4
#define KEY_A 3
#define KEY_R 2
#define KEY_T 1
#define KEY_S 0
// EYIO Row
#define EXT_2 9
#define KEY_E 8
#define KEY_Y 7
#define KEY_I 6
#define KEY_O 5
// EXTRA Row
#define EXT_7 14
#define EXT_6 13
#define EXT_5 12
#define EXT_4 11
#define EXT_3 10

// Define Offsets
#define LEADING_NONES NONE(0,0,0)
#define MIDDLE_NONES NONE(0, 0, 0)
#define TRAILING_NONES NONE(0, 0, 0)

// Include main ardux.io keymap
#include "../../../big_ardux.dtsi"